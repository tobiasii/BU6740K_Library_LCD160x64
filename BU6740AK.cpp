/**
 * @file BU6740AK.h
 * @author Tobias Salazar (you@domain.com)
 * @brief 	Biblioteca C com intuito de ser generica para qualquer arquitetura de MCU com SPI(Hardware ou Software)
 * 			para comunicação com Painel de Impressora HP com BU6740AK 
 * 			Codigo teve como base a library do site 'http:\\cocus.dx.am\2017\05\04\hp-3550-glcd-hack\'			
 * @version 1.0
 * @date 2020-09-20 
 * 
 * @copyright Copyright (c) 2020
 * 
 */

#include "BU6740AK.h"


unsigned int GLCD_Init[] = { 0xF000,
						 0xF000,
						 0xF30A,
						 0xA000,
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						 0x2006,
						 0x6023 /* end of init */};

unsigned char System5x7[] =
{
	0x00, 0x00, 0x00, 0x00, 0x00,// (space)
	0x00, 0x00, 0x5F, 0x00, 0x00,// !
	0x00, 0x07, 0x00, 0x07, 0x00,// "
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	0x08, 0x1C, 0x2A, 0x08, 0x08 // <-
};

unsigned char KeyIcons[] = { 
	0x00, 0x00, 0x00, 0x00, 0x00, 0x00, 0x00, 0x00,
	0x08, 0x0C, 0x0E, 0x0F, 0x0E, 0x0C, 0x08, 0x00,		// up 
	0x01, 0x03, 0x07, 0x0F, 0x07, 0x03, 0x01, 0x00,		// down
	0x04, 0x4E, 0x5F, 0x44, 0x44, 0x44, 0x38, 0x00,		// back 
	0x00, 0x2A, 0x2A, 0x2A, 0x2A, 0x2A, 0x2A, 0x00,		// menu
	0x1C, 0x22, 0x55, 0x49, 0x55, 0x22, 0x1C, 0x00,		// stop 
	0x08, 0x10, 0x20, 0x10, 0x08, 0x04, 0x02, 0x01,		// tick 
	0x00, 0x06, 0x01, 0xB1, 0x09, 0x06, 0x00, 0x00,		// help
};

int Init(BU6740AK *Painel , unsigned int(*Send16)(unsigned int) , void (*Start)(void) ,void (*Stop)(void) )
{
	if(Painel && Send16 && Start && Stop ){
            int i ;

		Painel->Start = Start ;
		Painel->_Send16 = Send16;
		Painel->Stop = Stop;

		Painel->Start();

		for (i = 0; i < (sizeof(GLCD_Init) / sizeof(GLCD_Init[0])); i ++)
		{
			Painel->_Send16(GLCD_Init[i]);
		}

		Painel->Stop();
	}
	else{
		if(!Painel)
			return 1;
		if(!Send16)
			return 2;
		if(!Start)
			return 3;
		if(!Stop)
			return 4;
	}
}

int GetKey(BU6740AK *Painel)
{	
	unsigned int ret;

	Painel->Start();

	/* It's mandatory to send this, even if we dont care for it's output */
	ret =Painel->_Send16(0xFA00);
	if (ret != 0x4001) return -1;				/* check for communication errors */
	ret =Painel->_Send16(0xF900);
	if ((ret & 0x4A00) != 0x4A00) return -1;	/* check for communication errors */

	/* First group of inputs (0xF8000) */
	ret =Painel->_Send16(0xF800);
	if ((ret & 0x4900) != 0x4900) return -1;	/* check for communication errors */

	Painel->KBState.Help = (ret & 0x01) == 0;
	Painel->KBState.Tick = (ret & 0x02) == 0;
	Painel->KBState.Down = (ret & 0x04) == 0;
	Painel->KBState.Back = (ret & 0x08) == 0;
	Painel->KBState.Up =   (ret & 0x10) == 0;	

	/* Second group of inputs (0xF7000) */
	ret =Painel->_Send16(0xF700);
	if ((ret & 0x4800) != 0x4800) return -1;	/* check for communication errors */

	Painel->KBState.Menu = (ret & 0x80) == 0;
	Painel->KBState.Stop = (ret & 0x40) == 0;

	/* It's mandatory to send this, even if we dont care for it's output */
	Painel->_Send16(0xF600);
	Painel->_Send16(0xF500);
	Painel->_Send16(0xF400);
	Painel->_Send16(0xF300);
	Painel->_Send16(0xF200);
	Painel->_Send16(0xF100);
	Painel->_Send16(0xF000);

	Painel->Stop();
	return  0 ;
}

void SetLeds(BU6740AK *Painel , unsigned char leds)
{
	Painel->Start();
	/* 0x90XX, XX = pins to turn on or off */
	Painel->_Send16(0x9000 | ((leds) << 0));
	Painel->Stop();
}

void SendRows(BU6740AK *Painel , unsigned char row_data[], unsigned char count)
{
	Painel->Start();
	/* Fixed sequence */
	Painel->_Send16(0x2001);
	Painel->_Send16(0x6003);
	Painel->_Send16(0x2004);
	Painel->_Send16(0x6000 | (Painel->current_col));
	Painel->_Send16(0x60C0 | (Painel->current_row));
	Painel->_Send16(0x2007);
	while (count){
		Painel->_Send16(0x6000 | *row_data);
		row_data++;
		count--;
	}
	Painel->Stop();
}

void ClearScreen(BU6740AK *Painel)
{
	unsigned char col;
	unsigned char row;

	Painel->Start();
	
	for (col = 0; col < 20; col++)
	{
		/* Fixed sequence */
		Painel->_Send16(0x2001);
		Painel->_Send16(0x6003);
		Painel->_Send16(0x2004);
		Painel->_Send16(0x6000 | (col));
		Painel->_Send16(0x60C0);
		Painel->_Send16(0x2007);

		for (row = 0; row < 32; row++)
		{
			Painel->_Send16(0x6000); /* null pixels */
		}
	}

	Painel->Stop();
}

void SetColumn(BU6740AK *Painel,unsigned char col){
	if( col < 20 )
		Painel->current_col = col ;
}

void SetRow(BU6740AK *Painel,unsigned char row){
	if( row < 32 )
		Painel->current_row = row ;
}
void PrintText(BU6740AK *Painel ,unsigned char col, unsigned char row, char txt[] , unsigned char length )
{
  unsigned char i ;

	unsigned char rows[7];

	SetRow(Painel,row);

	for (i = 0; i < length ; i++)
	{
		unsigned char bits , sub_bit , row;
		SetColumn(Painel,i + col);

		for ( row = 0; row < 7; row++)
		{
			bits = 0;

			for ( sub_bit = 0; sub_bit < 5; sub_bit++)
			{
				bits |= (System5x7[((txt[i] - ' ') * 5) + sub_bit] & (1 << row)) >> row;
				
				if (sub_bit != 7)
				{
					bits <<= 1;
				}
			}

			rows[row] = bits;
		}

		SendRows(Painel,rows, 7);
	}
}

void PrintIcon(BU6740AK *Painel ,unsigned char col, unsigned char _row, unsigned char icon_id)
{
  unsigned char row , sub_bit;
	unsigned char rows[8];

	SetRow(Painel,_row);

	unsigned char bits;
	SetColumn(Painel,col);

	for (row = 0; row < 8; row++)
	{
		bits = 0;

		for ( sub_bit = 0; sub_bit < 8; sub_bit++)
		{
			bits |= (KeyIcons[(icon_id * 8) + sub_bit] & (1 << row)) >> row;
			
			if (sub_bit != 7)
			{
				bits <<= 1;
			}
		}

		rows[row] = bits;
	}

	SendRows(Painel,rows, 8);
}
